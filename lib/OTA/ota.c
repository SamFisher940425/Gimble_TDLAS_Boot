#include "string.h"

#include "usart.h"
#include "flash.h"

#include "ota.h"

#define UID_BASE 0x1FFFF7E8UL

extern uint8_t g_gimble_id;
extern volatile uint32_t g_ota_flag;
extern volatile uint32_t g_fw_size;

static const uint8_t aucCRCHi[], aucCRCLo[];

enum OTA_STATUS g_ota_status = OTA_STATUS_NOT_STARTED_IN_BOOT;

uint8_t valid_cmd_flag = 0;
uint64_t last_cmd_time = 0;
struct OTA_message active_rx_msg;
struct OTA_message valid_rx_msg;
struct OTA_message send_msg;

void OTA_Data_Frame_Receive(uint8_t one_char)
{
  static enum OTA_RECEIVE_STATE recv_state;
  static uint8_t *msg_ptr = (uint8_t *)&active_rx_msg;

  if (valid_cmd_flag)
    return;

  switch (recv_state)
  {
  case OTA_STATE_RECV_HEAD_1:
    if (one_char == OTA_FRAME_HEAD_1)
    {
      memset(&active_rx_msg, 0, sizeof(active_rx_msg));
      active_rx_msg.head.head_1 = one_char;

      recv_state = OTA_STATE_RECV_HEAD_2;
    }
    break;
  case OTA_STATE_RECV_HEAD_2:
    if (one_char == OTA_FRAME_HEAD_2)
    {
      active_rx_msg.head.head_2 = one_char;

      recv_state = OTA_STATE_RECV_SRC_ID;
    }
    else
    {
      recv_state = OTA_STATE_RECV_HEAD_1;
    }
    break;
  case OTA_STATE_RECV_SRC_ID:
    if (one_char == 0x00)
    {
      recv_state = OTA_STATE_RECV_DST_ID;
    }
    else
    {
      recv_state = OTA_STATE_RECV_HEAD_1;
    }
    break;
  case OTA_STATE_RECV_DST_ID:
    if (one_char == g_gimble_id)
    {
      recv_state = OTA_STATE_RECV_FUNC_CODE;
    }
    else
    {
      recv_state = OTA_STATE_RECV_HEAD_1;
    }
    break;
  case OTA_STATE_RECV_FUNC_CODE:
    if (one_char < OTA_FUNC_CODE_MAX)
    {
      active_rx_msg.head.func_code = one_char;

      recv_state = OTA_STATE_RECV_DATA_LEN;
    }
    else
    {
      recv_state = OTA_STATE_RECV_HEAD_1;
    }
    break;
  case OTA_STATE_RECV_DATA_LEN:
    active_rx_msg.head.data_len = one_char;

    if (active_rx_msg.head.data_len == 0)
    {
      recv_state = OTA_STATE_RECV_CHECK;
    }
    else
    {
      recv_state = OTA_STATE_RECV_DATA;
    }
    break;
  case OTA_STATE_RECV_DATA:
    active_rx_msg.data[active_rx_msg.tail_1++] = one_char;

    if (active_rx_msg.tail_1 >= active_rx_msg.head.data_len)
    {
      recv_state = OTA_STATE_RECV_CHECK;
    }
    break;
  case OTA_STATE_RECV_CHECK:
    for (uint16_t i = 0; i < active_rx_msg.head.data_len + sizeof(active_rx_msg.head); i++)
    {
      active_rx_msg.check += *(msg_ptr + i);
    }

    if (active_rx_msg.check == one_char)
    {
      recv_state = OTA_STATE_RECV_TAIL_1;
    }
    else
    {
      recv_state = OTA_STATE_RECV_HEAD_1;
    }
    break;
  case OTA_STATE_RECV_TAIL_1:
    if (one_char == OTA_FRAME_TAIL_1)
    {
      active_rx_msg.tail_1 = one_char;
      recv_state = OTA_STATE_RECV_TAIL_2;
    }
    else
    {
      recv_state = OTA_STATE_RECV_HEAD_1;
    }
    break;
  case OTA_STATE_RECV_TAIL_2:
    if (one_char == OTA_FRAME_TAIL_2)
    {
      active_rx_msg.tail_2 = one_char;
      memcpy(&valid_rx_msg, &active_rx_msg, sizeof(valid_rx_msg));
      valid_cmd_flag = 1;
    }
    else
    {
      recv_state = OTA_STATE_RECV_HEAD_1;
    }
    break;

  default:
    recv_state = OTA_STATE_RECV_HEAD_1;
    break;
  }
}

void OTA_CMD_Parse(void)
{
  uint32_t data_offset = 0;
  uint32_t data_len = 0;
  int32_t result = -1;
  uint16_t crc_calc, crc_get;
  static uint8_t erase_all_flag = 0;

  if (valid_cmd_flag == 0)
  {
    return;
  }

  last_cmd_time = HAL_GetTick();

  switch (valid_rx_msg.head.func_code)
  {
  case OTA_FC_BEGIN:
    if (0 == erase_all_flag)
    {
      result = Erase_All_Page();
      erase_all_flag = 1;
    }
    else
    {
      result = 0;
    }
    g_ota_status = OTA_STATUS_NOT_STARTED_IN_BOOT;
    Send_Response(OTA_FC_BEGIN, (uint8_t *)&result, 1);
    g_fw_size = *(uint32_t *)&valid_rx_msg.data[1];
    break;
  case OTA_FC_TRANSMIT:
    // update main data
    if (g_ota_status == OTA_STATUS_NOT_STARTED_IN_BOOT)
    {
      g_ota_status = OTA_STATUS_UPDATING;
    }
    data_offset = *(uint32_t *)&valid_rx_msg.data[0];
    data_len = valid_rx_msg.head.data_len - 4;
    if (data_len + data_offset > (Get_Flash_Size() - 16 - 1) * 0x400)
    {
      result = -2;
      g_ota_status = OTA_STATUS_FAIL;
      break;
    }
    // check if data blank or match
    if (!Check_Blank(MAIN_PROGRAM_ADDR + data_offset, data_len))
    {
      if (!Check_Match(MAIN_PROGRAM_ADDR + data_offset, &valid_rx_msg.data[5], data_len))
      {
        result = -2;
        g_ota_status = OTA_STATUS_FAIL;
      }
      else
      {
        result = 0;
      }
      erase_all_flag = 0;
    }
    else
    {
      result = Internal_Flash_Program(data_offset, &valid_rx_msg.data[5], data_len);
      erase_all_flag = 0;
    }
    Send_Response(OTA_FC_TRANSMIT, (uint8_t *)&result, 1);
    break;
  case OTA_FC_GET_STATE:
    Send_Response(OTA_FC_GET_STATE, (uint8_t *)&g_ota_status, 1);
    break;
  case OTA_FC_FINISH:
    // check crc
    crc_calc = Calc_CRC16((uint8_t *)MAIN_PROGRAM_ADDR, g_fw_size - 2);
    crc_get = *(uint16_t *)(MAIN_PROGRAM_ADDR + g_fw_size - 2);
    if (crc_calc == crc_get)
    {
      g_ota_status = OTA_STATUS_SUCCESS;
    }
    else
    {
      g_ota_status = OTA_STATUS_FAIL;
    }
    // response
    Send_Response(OTA_FC_FINISH, (uint8_t *)&g_ota_status, 1);
    break;
  case OTA_FC_RESET:
    // no data
    Send_Response(OTA_FC_RESET, (uint8_t *)&g_ota_status, 0);
    HAL_Delay(50);
    Jump_To_Main_Application();
    break;

  default:
    break;
  }

  valid_cmd_flag = 0;
}

void Send_Response(uint8_t func_code, uint8_t *data, uint8_t len)
{
  uint8_t *_tx_buf = (uint8_t *)&send_msg;
  send_msg.head.head_1 = OTA_FRAME_HEAD_1;
  send_msg.head.head_2 = OTA_FRAME_HEAD_2;
  send_msg.head.src_id = g_gimble_id;
  send_msg.head.dst_id = valid_rx_msg.head.src_id;
  send_msg.head.func_code = func_code;
  send_msg.head.data_len = len;
  send_msg.check = 0;

  if (data != 0 && len != 0)
  {
    memcpy(&send_msg.data[0], data, len);
  }
  for (uint32_t i = 0; i < send_msg.head.data_len + sizeof(send_msg.head); i++)
  {
    send_msg.check += _tx_buf[i];
  }
  send_msg.data[send_msg.head.data_len] = send_msg.check;
  send_msg.data[send_msg.head.data_len+1] = OTA_FRAME_TAIL_1;
  send_msg.data[send_msg.head.data_len+2] = OTA_FRAME_TAIL_2;

  HAL_UART_Transmit_DMA(&huart3, (uint8_t *)&send_msg, (sizeof(send_msg.head) + send_msg.head.data_len + 1));
}

uint16_t Calc_CRC16(uint8_t *pucFrame, uint32_t usLen)
{
  uint8_t ucCRCHi = 0xFF;
  uint8_t ucCRCLo = 0xFF;
  uint16_t iIndex;
  while (usLen--)
  {
    iIndex = ucCRCLo ^ *(pucFrame++);
    ucCRCLo = (uint8_t)(ucCRCHi ^ aucCRCHi[iIndex]);
    ucCRCHi = aucCRCLo[iIndex];
  }
  return (uint16_t)(ucCRCHi << 8 | ucCRCLo);
}

static const uint8_t aucCRCHi[] = {
    0x00, 0xC1, 0x81, 0x40, 0x01, 0xC0, 0x80, 0x41, 0x01, 0xC0, 0x80, 0x41,
    0x00, 0xC1, 0x81, 0x40, 0x01, 0xC0, 0x80, 0x41, 0x00, 0xC1, 0x81, 0x40,
    0x00, 0xC1, 0x81, 0x40, 0x01, 0xC0, 0x80, 0x41, 0x01, 0xC0, 0x80, 0x41,
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    0x00, 0xC1, 0x81, 0x40};

static const uint8_t aucCRCLo[] = {
    0x00, 0xC0, 0xC1, 0x01, 0xC3, 0x03, 0x02, 0xC2, 0xC6, 0x06, 0x07, 0xC7,
    0x05, 0xC5, 0xC4, 0x04, 0xCC, 0x0C, 0x0D, 0xCD, 0x0F, 0xCF, 0xCE, 0x0E,
    0x0A, 0xCA, 0xCB, 0x0B, 0xC9, 0x09, 0x08, 0xC8, 0xD8, 0x18, 0x19, 0xD9,
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    0x41, 0x81, 0x80, 0x40};
